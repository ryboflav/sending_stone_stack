## firmware/main/Kconfig.projbuild
```kconfig
menu "Speaking Stone Firmware"

config SPEAKING_STONE_WIFI_SSID
    string "Wi-Fi SSID"
    default "your-ssid"
    help
        SSID for Wi-Fi station mode.

config SPEAKING_STONE_WIFI_PASSWORD
    string "Wi-Fi password"
    default "your-password"
    help
        Password for Wi-Fi station mode.

endmenu
```

## firmware/sdkconfig.defaults
```kconfig
CONFIG_SPEAKING_STONE_WIFI_SSID="your-ssid"
CONFIG_SPEAKING_STONE_WIFI_PASSWORD="your-password"
```
